## opensource/swupdate/Config.in
```kconfig
config OPENSOURCE_SWUPDATE
    bool "build OPENSOURCE_SWUPDATE component"
    default y
    select SAH_SERVICES_MTD_UTILS
    select SAH_SERVICES_MTD_UTILS_DEVEL
config OPENSOURCE_SWUPDATE_HWREVISION
    string "swupdate hwrevision file"
    depends on OPENSOURCE_SWUPDATE
    default "/tmp/hwrevision"
config OPENSOURCE_SWUPDATE_SWVERSIONS
    string "swupdate sw-versions file"
    depends on OPENSOURCE_SWUPDATE
    default "/tmp/sw-versions"
config OPENSOURCE_SWUPDATE_HANDLER_UBI
    bool "enable UBI volumes update support"
    default n
config OPENSOURCE_SURICATTA
    bool "enable suricatta"
    default y
config OPENSOURCE_SURICATTA_SSL
    bool "enable suricatta ssl"
    depends on OPENSOURCE_SURICATTA
    default y
config OPENSOURCE_SURICATTA_HAWKBIT
    bool "enable suricatta hawkbit"
    depends on OPENSOURCE_SURICATTA
    default y
config OPENSOURCE_SWUPDATE_WEBSERVER
    bool "enable webserver support"
    default n
config OPENSOURCE_SWUPDATE_MONGOOSE
    bool "choose mongoose as webserver"
    depends on OPENSOURCE_SWUPDATE_WEBSERVER
    default y
config OPENSOURCE_SWUPDATE_MONGOOSEIPV6
    bool "enable ipv6 support on mongoose (dependancy not supported)"
    depends on OPENSOURCE_SWUPDATE_MONGOOSE
    default n
config OPENSOURCE_SWUPDATE_MONGOOSESSL
    bool "enable ssl support on mongoose (dependancy not supported)"
    depends on OPENSOURCE_SWUPDATE_MONGOOSE
    default n
config OPENSOURCE_SWUPDATE_INSTALL_WEB_EXAMPLE
    bool "install web example"
    depends on OPENSOURCE_SWUPDATE_MONGOOSE
    default n
config OPENSOURCE_SWUPDATE_RELEASE_WEB_EXAMPLE
    bool "release web example"
    depends on OPENSOURCE_SWUPDATE_INSTALL_WEB_EXAMPLE
    default y
    help
      Release web server example to rootfs during release step.
      If disabled, web server example sources will remain in staging only.
config OPENSOURCE_SWUPDATE_INSTALL_WEB_EXAMPLE_PATH
    string "path of the web example on the target"
    depends on OPENSOURCE_SWUPDATE_INSTALL_WEB_EXAMPLE
    default ""
```
